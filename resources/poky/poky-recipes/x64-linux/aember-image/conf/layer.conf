## resources/poky/poky-recipes/x64-linux/aember-image/conf/layer.conf
```bitbake
# We are layer 'aember-image'
BBPATH .= ":${LAYERDIR}"
BBFILES += "${LAYERDIR}/recipes-*/*/*.bb \
            ${LAYERDIR}/recipes-*/*/*.bbappend"

BBFILE_COLLECTIONS += "aember"
BBFILE_PATTERN_aember = "^${LAYERDIR}/"
BBFILE_PRIORITY_aember = "6"


LAYERSERIES_COMPAT_aember = "whinlatter"
```

## resources/poky/poky-recipes/x64-linux/conf/bblayers.conf
```bitbake
BBLAYERS ?= " \
  /aember_mountfs/aember_ws/aember/poky/meta \
  /aember_mountfs/aember_ws/aember/poky/meta-poky \
  /aember_mountfs/aember_ws/aember/poky/meta-yocto-bsp \
  /aember_mountfs/aember_ws/aember/resources/poky/poky-recipes/x64-linux/aember-image \
"
```

## resources/poky/poky-recipes/x64-linux/conf/local.conf
```bitbake
MACHINE ?= "qemux86-64"
DISTRO ?= "poky"

INITRAMFS_IMAGE = "aember-initramfs"
INITRAMFS_IMAGE_NAME = "aember-initramfs-${MACHINE}.rootfs"

DL_DIR ?= "/home/arian/aember_ws/aember/resources/poky/poky-cache/universal/downloads"
SSTATE_DIR ?= "/home/arian/aember_ws/aember/resources/poky/poky-cache/x64-linux/sstate-cache"
TMPDIR = "/home/arian/aember_ws/aember/resources/poky/poky-cache/x64-linux/tmp"

# Only generate an initramfs cpio
IMAGE_FSTYPES = "cpio.gz"

# No extras
EXTRA_IMAGE_FEATURES = ""
IMAGE_FEATURES = ""

# Use smallest package format
PACKAGE_CLASSES = "package_ipk"

# Force busybox for runtime
VIRTUAL-RUNTIME_init_manager = "busybox"
VIRTUAL-RUNTIME_initscripts = ""
VIRTUAL-RUNTIME_login_manager = "busybox"
VIRTUAL-RUNTIME_dev_manager = "busybox-mdev"

# Bundle our custom initramfs
INITRAMFS_IMAGE = "aember-initramfs"
INITRAMFS_IMAGE_BUNDLE = "1"
```

## resources/yocto/x64-linux/aember-image/conf/layer.conf
```bitbake
# Layer configuration for meta-myinit
BBPATH .= ":${LAYERDIR}"
BBFILES += "${LAYERDIR}/recipes-*/*/*.bb"

BBFILE_COLLECTIONS += "myinit"
BBFILE_PATTERN_myinit = "^${LAYERDIR}/"
BBFILE_PRIORITY_myinit = "6"
```

## resources/yocto/x64-linux/conf/bblayers.conf
```bitbake
BBPATH = "${TOPDIR}"
BBFILES ?= ""

BBLAYERS ?= " \
  ${TOPDIR}/../../../poky/meta \
  ${TOPDIR}/../../../poky/meta-poky \
  ${TOPDIR}/../../../poky/meta-yocto-bsp \
  ${TOPDIR}/aember-image \
"
```

## yocto/meta-aember/conf/layer.conf
```bitbake
BBPATH .= ":${LAYERDIR}"
BBFILES += "${LAYERDIR}/recipes-*/*/*.bb"

BBFILE_COLLECTIONS += "aember"
BBFILE_PATTERN_aember := "^${LAYERDIR}/"
BBFILE_PRIORITY_aember = "6"

# THIS IS THE COMPATIBILITY LIST
LAYERSERIES_COMPAT_aember = "whinlatter"
```

## yocto/meta-aember/conf/machine/arm-linux.conf
```bitbake
# Standard override for ARM32
MACHINEOVERRIDES =. "arm:"

require conf/machine/include/arm/armv7a/tune-cortexa9.inc

KERNEL_IMAGETYPE = "zImage"
SERIAL_CONSOLES = "115200;ttyAMA0"
PREFERRED_PROVIDER_virtual/kernel = "aember-kernel"

# ARM32 specific settings
DEFAULTTUNE = "cortexa9hf-neon"
```

## yocto/meta-aember/conf/machine/x64-linux.conf
```bitbake
# Standard override for x86_64
MACHINEOVERRIDES =. "x86-64:"

require conf/machine/include/x86/tune-core2.inc

KERNEL_IMAGETYPE = "bzImage"
SERIAL_CONSOLES = "115200;ttyS0"
PREFERRED_PROVIDER_virtual/kernel = "linux-aember"

DEFAULTTUNE = "core2-64"
```
